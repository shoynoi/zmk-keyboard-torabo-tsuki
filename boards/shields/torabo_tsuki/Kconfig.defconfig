## boards/shields/torabo_tsuki/Kconfig.defconfig
```kconfig
if SHIELD_TORABO_TSUKI_LEFT || SHIELD_TORABO_TSUKI_RIGHT

config ZMK_KEYBOARD_NAME
    default "torabo-tsuki"

config ZMK_SPLIT
    default y

config SPI
    default y if ZMK_SPLIT_ROLE_CENTRAL

config INPUT
    default y if ZMK_SPLIT_ROLE_CENTRAL

config ZMK_MOUSE
    default y if ZMK_SPLIT_ROLE_CENTRAL

config PMW3610
    default y if ZMK_SPLIT_ROLE_CENTRAL
 
endif
```

## config/west.yml
```yaml
manifest:
  remotes:
    - name: zmkfirmware
      url-base: https://github.com/zmkfirmware
    - name: sekigon-gonnoc
      url-base: https://github.com/sekigon-gonnoc
    - name: kumamuk-git
      url-base: https://github.com/kumamuk-git
  projects:
    - name: zmk
      remote: zmkfirmware
      revision: main
      import: app/west.yml
    - name: zmk-component-ble-micro-pro
      remote: sekigon-gonnoc
      revision: main
    - name: zmk-driver-kscan-74hc164-matrix
      remote: sekigon-gonnoc
    - name: zmk-feature-status-led
      remote: sekigon-gonnoc
      revision: main
    - name: zmk-feature-cdc-acm-bootloader-trigger
      remote: sekigon-gonnoc
      revision: main
    - name: zmk-pmw3610-driver
      remote: kumamuk-git
      revision: main
  self:
    path: config
```
